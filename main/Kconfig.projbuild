## main/Kconfig.projbuild
```kconfig
menu "firmware settings"

    config MICRO_ROS_APP_STACK
        int "Stack the micro-ROS app (Bytes)"
        default 16000
        help
        Stack size in Bytes of the micro-ROS app

    config MICRO_ROS_APP_TASK_PRIO
        int "Priority of the micro-ROS app"
        default 5
        help
        Priority of micro-ros task higher value means higher priority

    config RMW_UXRCE_TRANSPORT_CUSTOM
        bool "Use Custom micro-ROS transport"
        default y

    config MICRO_ROS_UART_PORT
        int "UART port for micro-ROS communication"
        default 1
        help
            Use this UART (e.g. UART_NUM_1) for the micro-ROS custom transport.
    
    config DEBUG_UART_PORT
        int "UART port for debug output"
        default 0
        help
            Use this UART (e.g. UART_NUM_0 or the native USB) for debugging/logging.
        
endmenu
```
